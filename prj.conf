## prj.conf
```kconfig
CONFIG_BLUETOOTH=y
CONFIG_BLUETOOTH_DEBUG_LOG=y
CONFIG_BLUETOOTH_SMP=y
CONFIG_BLUETOOTH_SIGNING=y
CONFIG_BLUETOOTH_PERIPHERAL=y
CONFIG_BLUETOOTH_ATT_PREPARE_COUNT=2
CONFIG_BLUETOOTH_GATT_DYNAMIC_DB=y
CONFIG_BLUETOOTH_PRIVACY=y
CONFIG_BLUETOOTH_DEVICE_NAME="Firewatch"
CONFIG_SPI=y
CONFIG_SPI_0=y
CONFIG_SPI_0_IRQ_PRI=0
CONFIG_SPI_NRF5=y
CONFIG_SPIM0_NRF52=y
CONFIG_SPIM0_NRF52_GPIO_SCK_PIN=25
CONFIG_SPIM0_NRF52_GPIO_MOSI_PIN=23
CONFIG_SPIM0_NRF52_GPIO_MISO_PIN=24
```

## src/main.c
```c
#include <zephyr/types.h>
#include <stddef.h>
#include <string.h>
#include <errno.h>
#include <misc/printk.h>
#include <misc/byteorder.h>
#include <zephyr.h>

#include <board.h>
#include <gpio.h>

#include "b_generator.h"
#include "common.h"
#include "r_generator.h"

static void button_event(void)
{
	struct event event = {
		.sensor_addr = 0x00,
		.timestamp = k_uptime_get(),
		.event_type = 1,
		.event_data = 0,
	};

	while (k_msgq_put(&event_queue, &event, K_NO_WAIT) != 0)
		k_msgq_purge(&event_queue);
}

static void button_pressed(struct device *gpio, struct gpio_callback *cb,
			u32_t pins)
{
	unsigned int i;

	for (i = SW0_GPIO_PIN; i <= SW3_GPIO_PIN; i++)
		if (pins & BIT(i))
			printk("Button %u pressed at %u\n", (unsigned int) (i - SW0_GPIO_PIN),
				(unsigned int) k_uptime_get());

	if (pins & BIT(SW0_GPIO_PIN))
		button_event();

	if (pins & BIT(SW1_GPIO_PIN))
		toggle_r_generation();

	if (pins & BIT(SW2_GPIO_PIN))
		toggle_b_generation();
}

static struct gpio_callback gpio_cb;

static void init_buttons(void)
{
	struct device *gpio;

	gpio = device_get_binding(SW0_GPIO_NAME);
	if (!gpio) {
		printk("Failed to get gpio\n");
		return;
	}

	gpio_pin_configure(gpio, SW0_GPIO_PIN,
			GPIO_DIR_IN | GPIO_PUD_PULL_UP |
			GPIO_INT | GPIO_INT_EDGE | GPIO_INT_ACTIVE_LOW);
	gpio_pin_configure(gpio, SW1_GPIO_PIN,
			GPIO_DIR_IN | GPIO_PUD_PULL_UP |
			GPIO_INT | GPIO_INT_EDGE | GPIO_INT_ACTIVE_LOW);
	gpio_pin_configure(gpio, SW2_GPIO_PIN,
			GPIO_DIR_IN | GPIO_PUD_PULL_UP |
			GPIO_INT | GPIO_INT_EDGE | GPIO_INT_ACTIVE_LOW);
	gpio_pin_configure(gpio, SW3_GPIO_PIN,
			GPIO_DIR_IN | GPIO_PUD_PULL_UP |
			GPIO_INT | GPIO_INT_EDGE | GPIO_INT_ACTIVE_LOW);
	gpio_init_callback(&gpio_cb, button_pressed,
			BIT(SW0_GPIO_PIN) | BIT(SW1_GPIO_PIN) |
			BIT(SW2_GPIO_PIN) | BIT(SW3_GPIO_PIN));
	gpio_add_callback(gpio, &gpio_cb);
	gpio_pin_enable_callback(gpio, SW0_GPIO_PIN);
	gpio_pin_enable_callback(gpio, SW1_GPIO_PIN);
	gpio_pin_enable_callback(gpio, SW2_GPIO_PIN);
	gpio_pin_enable_callback(gpio, SW3_GPIO_PIN);
}

#define BLE_STACK_SIZE	2000
#define BLE_PRIORITY	-1
K_THREAD_DEFINE(ble_tid, BLE_STACK_SIZE,
		ble_main, NULL, NULL, NULL,
		BLE_PRIORITY, K_ESSENTIAL, K_NO_WAIT);

#define NRF_STACK_SIZE	500
#define NRF_PRIORITY	1
K_THREAD_DEFINE(nrf_tid, NRF_STACK_SIZE,
		nrf_main, NULL, NULL, NULL,
		NRF_PRIORITY, K_ESSENTIAL, K_NO_WAIT);

void main(void)
{
	init_buttons();
}
```

## src/b_generator.c
```c
#include "b_generator.h"
#include "common.h"

enum state {
	STATE_START,
	STATE_KOSZ,
	STATE_SRODEK,
	STATE_MOTOPOMPA,
	STATE_SSAWNE,
	STATE_ROZDZIELACZ,
	STATE_POMOCNIK,
	STATE_PRZODOWNIK,
	STATE_PACHOLEK_1,
	STATE_PACHOLEK_2,
	STATE_PACHOLEK_3,
	STATE_PACHOLEK_4,
	NUM_STATES,
};

static enum state b_state;

static void b_event(enum state state)
{
	struct event event = {
		.sensor_addr = 0xB0 + state,
		.timestamp = k_uptime_get(),
		.event_type = state,
		.event_data = 0,
	};

	while (k_msgq_put(&event_queue, &event, K_NO_WAIT) != 0)
		k_msgq_purge(&event_queue);
}

static void generate_b_event(struct k_timer *timer);
K_TIMER_DEFINE(b_generation_timer, generate_b_event, NULL);

static void generate_b_event(struct k_timer *timer)
{
	static const u32_t state_timeouts[NUM_STATES] = {
		[STATE_START] = 0,
		[STATE_KOSZ] = 7000,
		[STATE_SRODEK] = 2000,
		[STATE_MOTOPOMPA] = 2000,
		[STATE_SSAWNE] = 2000,
		[STATE_ROZDZIELACZ] = 7000,
		[STATE_POMOCNIK] = 4000,
		[STATE_PRZODOWNIK] = 3000,
		[STATE_PACHOLEK_1] = 500,
		[STATE_PACHOLEK_2] = 500,
		[STATE_PACHOLEK_3] = 500,
		[STATE_PACHOLEK_4] = 500,
	};

	b_event(b_state);
	b_state++;

	if (b_state < NUM_STATES)
		k_timer_start(&b_generation_timer, K_MSEC(state_timeouts[b_state]), 0);
	else
		b_state = STATE_START;
}

void toggle_b_generation(void)
{
	if (k_timer_remaining_get(&b_generation_timer)) {
		k_timer_stop(&b_generation_timer);
	} else {
		b_state = STATE_START;
		k_timer_start(&b_generation_timer,
			K_MSEC(1), K_MSEC(0));
	}
}
```

## src/b_generator.h
```c
#pragma once

void toggle_b_generation(void);
```

## src/ble.c
```c
#include <zephyr.h>
#include <bluetooth/bluetooth.h>
#include <bluetooth/hci.h>
#include <bluetooth/conn.h>
#include <bluetooth/uuid.h>
#include <bluetooth/gatt.h>

#include "common.h"

#define DEVICE_NAME		CONFIG_BLUETOOTH_DEVICE_NAME
#define DEVICE_NAME_LEN		(sizeof(DEVICE_NAME) - 1)

static struct bt_uuid_128 event_uuid = BT_UUID_INIT_128(
	0xf0, 0xee, 0xbc, 0x9a, 0x78, 0x56, 0x34, 0x12,
	0x78, 0x56, 0x34, 0x12, 0x78, 0x56, 0x34, 0x12);

static struct bt_gatt_ccc_cfg event_ccc_cfg[CONFIG_BLUETOOTH_MAX_PAIRED] = {};

K_SEM_DEFINE(indicate_enabled_sem, 0, UINT_MAX);
static u8_t indicate_enabled = 0;

static u8_t indicating_event_success = 0;

static struct bt_gatt_indicate_params event_ind_params;

static void event_ccc_cfg_changed(const struct bt_gatt_attr *attr, u16_t value)
{
	printk("event_ccc_cfg_changed %p %u\n", attr, (unsigned int) value);
	indicate_enabled = (value == BT_GATT_CCC_INDICATE) ? 1 : 0;
	k_sem_give(&indicate_enabled_sem);
}

K_SEM_DEFINE(indicating_sem, 0, UINT_MAX);
static void event_indicate_cb(struct bt_conn *conn, const struct bt_gatt_attr *attr,
			u8_t err)
{
	printk("Event indication %s\n", err != 0 ? "fail" : "success");
	indicating_event_success = (err ? 0 : 1);
	k_sem_give(&indicating_sem);
}

static const struct bt_uuid_128 event_chr_uuid = BT_UUID_INIT_128(
	0xf1, 0xee, 0xbc, 0x9a, 0x78, 0x56, 0x34, 0x13,
	0x78, 0x56, 0x34, 0x12, 0x78, 0x56, 0x34, 0x13);

static ssize_t read_time(struct bt_conn *conn, const struct bt_gatt_attr *attr,
			void *buf, u16_t len, u16_t offset)
{
	static u32_t current_time;

	current_time = k_uptime_get();

	return bt_gatt_attr_read(conn, attr, buf, len, offset, &current_time,
				sizeof(current_time));
}

static const struct bt_uuid_128 uptime_chr_uuid = BT_UUID_INIT_128(
	0xf2, 0xee, 0xbc, 0x9a, 0x78, 0x56, 0x34, 0x13,
	0x78, 0x56, 0x34, 0x12, 0x78, 0x56, 0x34, 0x13);

static struct bt_gatt_attr event_attrs[] = {
	BT_GATT_PRIMARY_SERVICE(&event_uuid),
	BT_GATT_CHARACTERISTIC(&event_chr_uuid.uuid,
			BT_GATT_CHRC_INDICATE),
	BT_GATT_DESCRIPTOR(&event_chr_uuid.uuid,
			BT_GATT_PERM_NONE,
			NULL, NULL, NULL),
	BT_GATT_CCC(event_ccc_cfg, event_ccc_cfg_changed),
	BT_GATT_CHARACTERISTIC(&uptime_chr_uuid.uuid,
			BT_GATT_CHRC_READ),
	BT_GATT_DESCRIPTOR(&uptime_chr_uuid.uuid,
			BT_GATT_PERM_READ,
			read_time, NULL, NULL),
};

static const struct bt_data ad[] = {
	BT_DATA_BYTES(BT_DATA_FLAGS, (BT_LE_AD_GENERAL | BT_LE_AD_NO_BREDR)),
	BT_DATA_BYTES(BT_DATA_UUID16_ALL,
		      0x0d, 0x18, 0x0f, 0x18, 0x05, 0x18),
	BT_DATA_BYTES(BT_DATA_UUID128_ALL,
		      0xf0, 0xee, 0xbc, 0x9a, 0x78, 0x56, 0x34, 0x12,
		      0x78, 0x56, 0x34, 0x12, 0x78, 0x56, 0x34, 0x12),
};

static const struct bt_data sd[] = {
	BT_DATA(BT_DATA_NAME_COMPLETE, DEVICE_NAME, DEVICE_NAME_LEN),
};

static struct bt_conn *bt_connection = NULL;

static void connected(struct bt_conn *conn, u8_t err)
{
	if (err) {
		printk("Connection failed (err %u)\n", err);
	} else {
		printk("Connected\n");
		bt_connection = conn;
	}
}

static void disconnected(struct bt_conn *conn, u8_t reason)
{
	printk("Disconnected (reason %u)\n", reason);
	bt_connection = NULL;
}

static struct bt_conn_cb conn_callbacks = {
	.connected = connected,
	.disconnected = disconnected,
};

static void bt_ready(int err)
{
	if (err) {
		printk("Bluetooth init failed (err %d)\n", err);
		return;
	}

	printk("Bluetooth initialized\n");

	bt_gatt_register(event_attrs, ARRAY_SIZE(event_attrs));

	err = bt_le_adv_start(BT_LE_ADV_CONN, ad, ARRAY_SIZE(ad),
			      sd, ARRAY_SIZE(sd));
	if (err) {
		printk("Advertising failed to start (err %d)\n", err);
		return;
	}

	printk("Advertising successfully started\n");
}

K_MSGQ_DEFINE(event_queue, sizeof(struct event), 100, 4);

void ble_main(void *p1, void *p2, void *p3)
{
	int err;

	err = bt_enable(bt_ready);
	if (err) {
		printk("Bluetooth init failed (err %d)\n", err);
		return;
	}

	bt_conn_cb_register(&conn_callbacks);

	while (1) {
		struct event event;

		printk("checking queue size=%u\n", (unsigned int) k_msgq_num_used_get(&event_queue));

		while (k_msgq_get(&event_queue, &event, K_FOREVER) == 0) {
			printk("Sending new event!\n");
			do {
				int err;

				event_ind_params.attr = &event_attrs[2];
				event_ind_params.func = event_indicate_cb;
				event_ind_params.data = &event;
				event_ind_params.len = sizeof(event);

				printk("sending event with ts=%u\n", (unsigned int) event.timestamp);

			        while (!indicate_enabled)
					k_sem_take(&indicate_enabled_sem, K_FOREVER);

				if ((err = bt_gatt_indicate(bt_connection, &event_ind_params)) != 0) {
					printk("request indication error err = %d\n", err);
					continue;
				} else {
					printk("request indication ok\n");
				}

				k_sem_take(&indicating_sem, K_FOREVER);
				printk("Indication confirmed\n");
			} while (!indicating_event_success);
		}

		printk("No more events in queue?\n");
	}
}
```

## src/common.h
```c
#pragma once

#include <zephyr.h>

struct event {
	u32_t sensor_addr;
	u32_t timestamp;
	u32_t event_type;
	u32_t event_data;
} __packed;

extern struct k_msgq event_queue;

extern void ble_main(void *, void *, void *);
extern void nrf_main(void *, void *, void *);
```

## src/msg.h
```c
#include <zephyr.h>

#define MSG_PWR_ON	0x00
#define MSG_IR_ONOFF	0x10
#define MSG_IR_USR	0x18
#define MSG_MAG_ONOFF	0x20
#define MSG_MAG_RAW	0x22
#define MSG_STRING	0xf0

struct msg_header {
	uint32_t ts;
	uint8_t type;
} __attribute__((__packed__));

#define MSG_HEADER_LEN	(sizeof(struct msg_header))
```

## src/nrf.c
```c
#include <zephyr.h>
#include <misc/printk.h>

#include <device.h>
#include <spi.h>

#include "common.h"
#include "nrf24.h"
#include "msg.h"

#ifdef VERBOSE_DEBUG

#ifndef vprintk
#define vprintk printk
#endif

#else

#ifndef vprintk
#define vprintk(fmt, arg...) do { } while (0)
#endif

#endif

K_SEM_DEFINE(nrf_ready_sem, 0, UINT_MAX);
static volatile int nrf_ready = 0;

static void nrf_irq_callback(struct device *port,
			struct gpio_callback *cb, uint32_t pin)
{
	struct nrf24 *nrf = CONTAINER_OF(cb, struct nrf24, irq_cb);
	ARG_UNUSED(nrf);

	nrf_ready = 1;
	k_sem_give(&nrf_ready_sem);
}

static struct nrf24_config nrf_config = {
	.spi_port = "SPI_0",

	.cs_port = "GPIO_0",
	.cs_pin = 11,

	.ce_port = "GPIO_0",
	.ce_pin = 12,

	.irq_port = "GPIO_0",
	.irq_pin = 20,
	.irq_callback = nrf_irq_callback,

	.payload_size = 0,
};

static struct nrf24 nrf;

#ifdef VERBOSE_DEBUG
static void nrf_print_addr(unsigned int pipe, uint64_t addr)
{
	vprintk("a%u: %02x%02x%02x%02x%02x\n",
		pipe,
		(unsigned int) ((addr >> 0) & 0xFF),
		(unsigned int) ((addr >> 8) & 0xFF),
		(unsigned int) ((addr >> 16) & 0xFF),
		(unsigned int) ((addr >> 24) & 0xFF),
		(unsigned int) ((addr >> 32) & 0xFF));
}
#endif

static void nrf24_local_init(struct nrf24 *nrf)
{
	uint8_t val;

	nrf24_init(nrf);

	/* RF Speed and power*/
	nrf24_set_byte(nrf, NRF24_RF_SETUP, NRF24_RF_DR_250K | NRF24_RF_PWR_0);

	/* Set to RX mode, 2-byte CRC */
	val = nrf24_get_byte(nrf, NRF24_CONFIG);
	nrf24_set_byte(nrf, NRF24_CONFIG, val | NRF24_PRIM_RX | NRF24_CRCO);
	nrf24_set_byte(nrf, NRF24_STATUS, NRF24_RX_DR);

	/* Address */
	nrf24_enable_rx_address(nrf,
				BIT(0) | BIT(1) | BIT(2) |
				BIT(3) | BIT(4) | BIT(5));
	nrf24_enable_aa(nrf,
			BIT(0) | BIT(1) | BIT(2) |
			BIT(3) | BIT(4) | BIT(5));
	nrf24_set_address_width(nrf, 3);
	nrf24_set_rx_address(nrf, 0, 0xABABABA001);
	nrf24_set_rx_address(nrf, 1, 0xABABABA002);
	nrf24_set_rx_address(nrf, 2, 0x03);
	nrf24_set_rx_address(nrf, 3, 0x04);
	nrf24_set_rx_address(nrf, 4, 0x05);
	nrf24_set_rx_address(nrf, 5, 0x06);

#if VERBOSE_DEBUG
	nrf_print_addr(0, nrf24_get_rx_address(nrf, 0));
	nrf_print_addr(1, nrf24_get_rx_address(nrf, 1));
#endif
}

static void send_event(uint32_t sensor_addr, uint32_t timestamp,
		uint32_t event_type, uint32_t event_data)
{
	struct event event = {
		.sensor_addr = sensor_addr,
		.timestamp = timestamp,
		.event_type = event_type,
		.event_data = event_data,
	};

	while (k_msgq_put(&event_queue, &event, K_NO_WAIT) != 0)
		k_msgq_purge(&event_queue);
}

static void dump_payload(int pipe, uint8_t *payload, unsigned int len)
{
	struct msg_header *header = (struct msg_header *) payload;
	uint8_t i;

	printk("%d: [%d %2u] ", pipe, header->ts, len);

#define CASE_MSG_TYPE(type)			\
	case MSG_ ## type:			\
		printk(#type " len = %u", len);	\
		break

	switch (header->type) {
	CASE_MSG_TYPE(PWR_ON);
	case MSG_IR_ONOFF: {
		uint32_t value = ((((uint32_t) payload[MSG_HEADER_LEN + 0]) << 0) |
				(((uint32_t) payload[MSG_HEADER_LEN + 1]) << 8) |
				(((uint32_t) payload[MSG_HEADER_LEN + 2]) << 16) |
				(((uint32_t) payload[MSG_HEADER_LEN + 3]) << 24));
		printk("IR_ONOFF %u", (unsigned int) value);
		send_event(pipe + 1, k_uptime_get() - header->ts,
			header->type, value);
		break;
	}
	CASE_MSG_TYPE(IR_USR);
	case MSG_MAG_ONOFF: {
		uint32_t value = ((((uint32_t) payload[MSG_HEADER_LEN + 0]) << 0) |
				(((uint32_t) payload[MSG_HEADER_LEN + 1]) << 8) |
				(((uint32_t) payload[MSG_HEADER_LEN + 2]) << 16) |
				(((uint32_t) payload[MSG_HEADER_LEN + 3]) << 24));
		printk("MAG_ONOFF %u", (unsigned int) value);
		send_event(pipe + 1, k_uptime_get() - header->ts,
			header->type, value);
		break;
	}
	case MSG_MAG_RAW: {
		uint32_t raw = ((((uint32_t) payload[MSG_HEADER_LEN + 0]) << 0) |
				(((uint32_t) payload[MSG_HEADER_LEN + 1]) << 8) |
				(((uint32_t) payload[MSG_HEADER_LEN + 2]) << 16) |
				(((uint32_t) payload[MSG_HEADER_LEN + 3]) << 24));
		printk("MAG_RAW	  %u", (unsigned int) raw);
		break;
	}
	case MSG_STRING:
		printk("STRING '%s'", &payload[MSG_HEADER_LEN]);
		break;
	default:
		printk("Unknown <0x%02x>", (unsigned int) header->type);
	}

	/* as bytes */
	vprintk(" [");
	for (i = 0; i < len; i++)
		vprintk(" %02x", (unsigned int) payload[i]);
	vprintk(" ]");

	printk("\n");
}

void process_payload(int pipe, uint8_t *payload, unsigned int len)
{
	static unsigned int buf[6][10] = {{0}};
	static unsigned int sum[6] = {0};
	static unsigned int idx[6] = {0};
	struct msg_header *header = (struct msg_header *) payload;
	unsigned int *pidx = &idx[pipe];
	unsigned int *psum = &sum[pipe];
	unsigned int *pbuf = &buf[pipe][*pidx];
	uint16_t mag;
	uint16_t vref;

	if (len < MSG_HEADER_LEN + 4 || header->type != MSG_MAG_RAW)
		return;

	mag = ((((uint16_t) payload[MSG_HEADER_LEN + 0]) << 0) |
		(((uint16_t) payload[MSG_HEADER_LEN + 1]) << 8));

	vref = ((((uint16_t) payload[MSG_HEADER_LEN + 2]) << 0) |
		(((uint16_t) payload[MSG_HEADER_LEN + 3]) << 8));

	*psum -= *pbuf;
	*pbuf = (1000000 * mag) / vref;
	*psum += *pbuf;

	if (*pidx == 0)
		printk("[%d] [%d] mag: %u, vref: %u, avg: %u\n",
			pipe, (int) header->ts,
			(unsigned int) mag,
			(unsigned int) vref,
			(unsigned int) (*psum / ARRAY_SIZE(buf[0])));
	*pidx = (*pidx + 1) % ARRAY_SIZE(buf[0]);
}

void nrf_main(void *p1, void *p2, void *p3)
{
	uint8_t rx_payload[32];
	uint8_t status;
	uint8_t fifo_status;
	int ret;

	printk("Hello World! %s\n", CONFIG_ARCH);
	printk("Initializing nrf24\n");

	/* nRF24 init */
	nrf.config = &nrf_config;
	nrf24_local_init(&nrf);

	/* power up */
	printk("Powering up\n");
	nrf24_power(&nrf, 1);

	/* Prepare receiver */
	printk("Enabling receiver\n");
	nrf24_ce(&nrf, 1);

	status = nrf24_status(&nrf);
	printk("STATUS = 0x%02x\n", (unsigned int) status);

	fifo_status = nrf24_get_byte(&nrf, NRF24_FIFO_STATUS);
	printk("FIFO_STATUS = 0x%02x\n", (unsigned int) fifo_status);

	while (1) {
		vprintk("Waiting for data\n");
		while (!nrf_ready)
			k_sem_take(&nrf_ready_sem, K_FOREVER);
		nrf_ready = 0;
		vprintk("There was an IRQ!\n");

		status = nrf24_status(&nrf);
		vprintk("STATUS = 0x%02x\n", (unsigned int) status);

		/* This is needed in case there was an interrupt (somehow) triggered but there is no data in RX FIFO */
		if (status & NRF24_RX_DR) {
			vprintk("Clearing NRF24_RX_DR\n");
			nrf24_set_byte(&nrf, NRF24_STATUS, NRF24_RX_DR);
			status &= ~(NRF24_RX_DR);
		} else {
			vprintk("Clearing NRF24_other interrupt\n");
			nrf24_set_byte(&nrf, NRF24_STATUS, status & (NRF24_TX_DS | NRF24_MAX_RT));
			status &= ~(NRF24_TX_DS | NRF24_MAX_RT);
		}

		while ((status & NRF24_RX_P_NO_MASK) != NRF24_RX_P_NO_MASK /*!(fifo_status & NRF24_FIFO_RX_EMPTY)*/) {
			if (status & NRF24_RX_DR) {
				vprintk("Clearing NRF24_RX_DR\n");
				nrf24_set_byte(&nrf, NRF24_STATUS, NRF24_RX_DR);
			}

			ret = nrf24_receive(&nrf, rx_payload);
			if (ret < 0) {
				vprintk("Received invalid packet (PL_WID invalid)\n");
				break;
			}
			dump_payload(NRF24_RX_P_NO(status), rx_payload, ret);

			status = nrf24_status(&nrf);
			vprintk("STATUS = 0x%02x\n", (unsigned int) status);
		}
	}
}
```

## src/nrf24.c
```c
#include "nrf24.h"

#include <logging/sys_log.h>
#include <spi.h>

static int nrf24_ce_init(struct nrf24 *nrf)
{
	const struct nrf24_config *cfg = nrf->config;

	nrf->ce = device_get_binding(cfg->ce_port);
	if (!nrf->ce) {
		SYS_LOG_DBG("GPIO controller %s not found.", cfg->ce_port);
		return -EINVAL;
	}

	gpio_pin_configure(nrf->ce, cfg->ce_pin, GPIO_DIR_OUT);

	return 0;
}

static int nrf24_cs_init(struct nrf24 *nrf)
{
	const struct nrf24_config *cfg = nrf->config;

	nrf->cs = device_get_binding(cfg->cs_port);
	if (!nrf->cs) {
		SYS_LOG_DBG("GPIO controller %s not found.", cfg->cs_port);
		return -EINVAL;
	}

	gpio_pin_configure(nrf->cs, cfg->cs_pin, GPIO_DIR_OUT);

	nrf24_cs(nrf, 1);

	return 0;
}

static int nrf24_irq_init(struct nrf24 *nrf)
{
	const struct nrf24_config *cfg = nrf->config;

	nrf->irq = device_get_binding(cfg->irq_port);
	if (!nrf->irq) {
		SYS_LOG_DBG("GPIO controller %s not found.", cfg->irq_port);
		return -EINVAL;
	}

	gpio_pin_configure(nrf->irq, cfg->irq_pin,
			GPIO_DIR_IN | GPIO_INT | GPIO_INT_EDGE |
			GPIO_INT_ACTIVE_LOW | GPIO_INT_DEBOUNCE);

	gpio_init_callback(&nrf->irq_cb,
			cfg->irq_callback,
			BIT(cfg->irq_pin));

	gpio_add_callback(nrf->irq, &nrf->irq_cb);
	gpio_pin_enable_callback(nrf->irq, cfg->irq_pin);

	return 0;
}

uint8_t nrf24_get_byte(struct nrf24 *nrf, uint8_t reg)
{
	uint8_t data_out[] = { reg };
	uint8_t data_in[2];

	nrf24_cs(nrf, 0);
	spi_transceive(nrf->spi_dev, data_out, ARRAY_SIZE(data_out),
		       data_in, ARRAY_SIZE(data_in));
	nrf24_cs(nrf, 1);

	nrf->status = data_in[0];
	return data_in[1];
}

void nrf24_set_byte(struct nrf24 *nrf, uint8_t reg, uint8_t val)
{
	uint8_t data_out[] = { reg | NRF24_W_REGISTER, val };
	/* Workaround for short output transfer */
	uint8_t data_in[ARRAY_SIZE(data_out)];

	nrf24_cs(nrf, 0);
	spi_transceive(nrf->spi_dev, data_out, ARRAY_SIZE(data_out),
		       data_in, ARRAY_SIZE(data_in));
	nrf24_cs(nrf, 1);

	nrf->status = data_in[0];
}

void nrf24_enable_aa(struct nrf24 *nrf, uint8_t pipes)
{
	nrf24_set_byte(nrf, NRF24_EN_AA,
		nrf24_get_byte(nrf, NRF24_EN_AA) | pipes);
}

void nrf24_enable_rx_address(struct nrf24 *nrf, uint8_t pipes)
{
	nrf24_set_byte(nrf, NRF24_EN_RXADDR,
		nrf24_get_byte(nrf, NRF24_EN_RXADDR) | pipes);
}

void nrf24_set_rx_address(struct nrf24 *nrf, uint8_t pipe, uint64_t address)
{
	uint8_t data_out[] = {
		(NRF24_RX_ADDR_P0 + pipe) | NRF24_W_REGISTER,
		(address >>  0) & 0xFF,
		(address >>  8) & 0xFF,
		(address >> 16) & 0xFF,
		(address >> 24) & 0xFF,
		(address >> 32) & 0xFF,
	};
	/* Workaround for short output transfer */
	uint8_t data_in[ARRAY_SIZE(data_out)];
	uint8_t data_out_len = (pipe < 2) ? ARRAY_SIZE(data_out) : 2;

	nrf24_cs(nrf, 0);
	spi_transceive(nrf->spi_dev,
		data_out, data_out_len,
		data_in, data_out_len);
	nrf24_cs(nrf, 1);

	nrf->status = data_in[0];
}

uint64_t nrf24_get_rx_address(struct nrf24 *nrf, uint8_t pipe)
{
	uint8_t data_out[] = { NRF24_RX_ADDR_P0 + pipe };
	uint8_t data_in[6];
	uint8_t data_in_len = pipe < 2 ? ARRAY_SIZE(data_in) : 2;

	nrf24_cs(nrf, 0);
	spi_transceive(nrf->spi_dev, data_out, ARRAY_SIZE(data_out),
		       data_in, data_in_len);
	nrf24_cs(nrf, 1);

	nrf->status = data_in[0];

	if (pipe < 2)
		return ((((uint64_t) data_in[1]) <<  0) |
			(((uint64_t) data_in[2]) <<  8) |
			(((uint64_t) data_in[3]) << 16) |
			(((uint64_t) data_in[4]) << 24) |
			(((uint64_t) data_in[5]) << 32));
	else
		return data_in[1];
}

void nrf24_set_tx_address(struct nrf24 *nrf, uint64_t address)
{
	uint8_t data_out[] = {
		NRF24_TX_ADDR | NRF24_W_REGISTER,
		(address >>  0) & 0xFF,
		(address >>  8) & 0xFF,
		(address >> 16) & 0xFF,
		(address >> 24) & 0xFF,
		(address >> 32) & 0xFF,
	};
	/* Workaround for short output transfer */
	uint8_t data_in[ARRAY_SIZE(data_out)];

	nrf24_cs(nrf, 0);
	spi_transceive(nrf->spi_dev, data_out, ARRAY_SIZE(data_out),
		       data_in, ARRAY_SIZE(data_in));
	nrf24_cs(nrf, 1);

	nrf->status = data_in[0];
}

uint64_t nrf24_get_tx_address(struct nrf24 *nrf)
{
	uint8_t data_out[] = { NRF24_TX_ADDR };
	uint8_t data_in[6];

	nrf24_cs(nrf, 0);
	spi_transceive(nrf->spi_dev, data_out, ARRAY_SIZE(data_out),
		       data_in, ARRAY_SIZE(data_in));
	nrf24_cs(nrf, 1);

	nrf->status = data_in[0];

	return ((((uint64_t) data_in[1]) <<  0) |
		(((uint64_t) data_in[2]) <<  8) |
		(((uint64_t) data_in[3]) << 16) |
		(((uint64_t) data_in[4]) << 24) |
		(((uint64_t) data_in[5]) << 32));
}

void nrf24_set_address_width(struct nrf24 *nrf, uint8_t width)
{
	nrf24_set_byte(nrf, NRF24_SETUP_AW, width + 2);
}

void nrf24_flush_tx(struct nrf24 *nrf)
{
	uint8_t data_out[] = { NRF24_FLUSH_TX };
	uint8_t data_in[1];

	nrf24_cs(nrf, 0);
	spi_transceive(nrf->spi_dev, data_out, ARRAY_SIZE(data_out),
		       data_in, ARRAY_SIZE(data_in));
	nrf24_cs(nrf, 1);

	nrf->status = data_in[0];
}

void nrf24_flush_rx(struct nrf24 *nrf)
{
	uint8_t data_out[] = { NRF24_FLUSH_RX };
	uint8_t data_in[1];

	nrf24_cs(nrf, 0);
	spi_transceive(nrf->spi_dev, data_out, ARRAY_SIZE(data_out),
		       data_in, ARRAY_SIZE(data_in));
	nrf24_cs(nrf, 1);

	nrf->status = data_in[0];
}

void nrf24_send(struct nrf24 *nrf, uint8_t *data, uint8_t size)
{
	uint8_t data_out[33] = { NRF24_W_TX_PAYLOAD };
	unsigned payload_size = nrf->config->payload_size;
	/* Workaround for short output transfer */
	uint8_t data_in[ARRAY_SIZE(data_out)];
	uint8_t i;

	if (!payload_size)
		payload_size = size;

	for (i = 0; i < size; i++)
		data_out[i + 1] = data[i];

	nrf24_cs(nrf, 0);
	spi_transceive(nrf->spi_dev, data_out, payload_size + 1,
		       data_in, payload_size + 1);
	nrf24_cs(nrf, 1);

	nrf->status = data_in[0];
}

int nrf24_receive(struct nrf24 *nrf, uint8_t *data)
{
	uint8_t data_in[33];
	uint8_t command;
	unsigned int payload_size = nrf->config->payload_size;
	uint8_t i;

	if (!payload_size) {
		command = NRF24_R_RX_PL_WID;
		nrf24_cs(nrf, 0);
		spi_transceive(nrf->spi_dev, &command, 1,
			data_in, 2);
		nrf24_cs(nrf, 1);

		payload_size = data_in[1];

		if (payload_size > 32) {
			nrf24_flush_rx(nrf);
			return -1;
		}
	}

	command = NRF24_R_RX_PAYLOAD;
	nrf24_cs(nrf, 0);
	spi_transceive(nrf->spi_dev, &command, 1,
		       data_in, payload_size + 1);
	nrf24_cs(nrf, 1);

	for (i = 0; i < payload_size; i++)
		data[i] = data_in[i + 1];

	nrf->status = data_in[0];

	return payload_size;
}

static int nrf24_spi_init(struct nrf24 *nrf)
{
	struct spi_config config = {
		.config = SPI_WORD(8),
		.max_sys_freq = 1000000, /* 1 MHz */
	};

	nrf->spi_dev = device_get_binding(nrf->config->spi_port);
	if (!nrf->spi_dev)
		return -ENODEV;

	return spi_configure(nrf->spi_dev, &config);
}

int nrf24_init(struct nrf24 *nrf)
{
	int ret;
	uint8_t val;

	ret = nrf24_cs_init(nrf);
	if (ret < 0)
		return ret;

	ret = nrf24_ce_init(nrf);
	if (ret < 0)
		return ret;

	ret = nrf24_irq_init(nrf);
	if (ret < 0)
		return ret;

	ret = nrf24_spi_init(nrf);
	if (ret < 0)
		return ret;

	/* Disable radio */
	nrf24_ce(nrf, 0);

	/* Power down */
	nrf24_power(nrf, 0);

	/* Clear interrupt registers */
	val = nrf24_status(nrf);
	val &= (NRF24_RX_DR | NRF24_TX_DS | NRF24_MAX_RT);
	if (val)
		nrf24_set_byte(nrf, NRF24_STATUS, val);

	/* Clear FIFOs */
	val = nrf24_get_byte(nrf, NRF24_FIFO_STATUS);
	while ((val & (NRF24_FIFO_TX_EMPTY | NRF24_FIFO_RX_EMPTY)) !=
			(NRF24_FIFO_TX_EMPTY | NRF24_FIFO_RX_EMPTY)) {
		if (!(val & NRF24_FIFO_TX_EMPTY))
			nrf24_flush_tx(nrf);

		if (!(val & NRF24_FIFO_RX_EMPTY))
			nrf24_flush_rx(nrf);

		val = nrf24_get_byte(nrf, NRF24_FIFO_STATUS);
	}

	/* Set payload length */
	if (nrf->config->payload_size) { /* Static payload length */
		nrf24_set_byte(nrf, NRF24_RX_PW_P0, nrf->config->payload_size);
		nrf24_set_byte(nrf, NRF24_RX_PW_P1, nrf->config->payload_size);
		nrf24_set_byte(nrf, NRF24_RX_PW_P2, nrf->config->payload_size);
		nrf24_set_byte(nrf, NRF24_RX_PW_P3, nrf->config->payload_size);
		nrf24_set_byte(nrf, NRF24_RX_PW_P4, nrf->config->payload_size);
		nrf24_set_byte(nrf, NRF24_RX_PW_P5, nrf->config->payload_size);
	} else { /* Dynamic payload length */
		nrf24_set_byte(nrf, NRF24_FEATURE, NRF24_EN_DPL);
		nrf24_set_byte(nrf, NRF24_DYN_PD, 0x3F);
	}

	return ret;
}

void nrf24_power(struct nrf24 *nrf, int on)
{
	uint8_t val;

	val = nrf24_get_byte(nrf, NRF24_CONFIG);
	if (on)
		val |= NRF24_PWR_UP;
	else
		val &= ~NRF24_PWR_UP;

	nrf24_set_byte(nrf, NRF24_CONFIG, val);
}

uint8_t nrf24_status(struct nrf24 *nrf)
{
	uint8_t data_out[] = { NRF24_NOP };
	uint8_t data_in[1];

	nrf24_cs(nrf, 0);
	spi_transceive(nrf->spi_dev, data_out, ARRAY_SIZE(data_out),
		data_in, ARRAY_SIZE(data_in));
	nrf24_cs(nrf, 1);

	nrf->status = data_in[0];
	return data_in[0];
}
```

## src/nrf24.h
```c
#pragma once

#include <zephyr.h>
#include <gpio.h>

/* Commands */
#define NRF24_R_REGISTER	0x00
#define NRF24_W_REGISTER	0x20
#define NRF24_R_RX_PAYLOAD	0x61
#define NRF24_W_TX_PAYLOAD	0xA0
#define NRF24_FLUSH_TX		0xE1
#define NRF24_FLUSH_RX		0xE2
#define NRF24_REUSE_TX_PL	0xE3
#define NRF24_R_RX_PL_WID	0x60
#define NRF24_NOP		0xFF

/* Register addresses */
#define NRF24_CONFIG		0x00
#define NRF24_EN_AA		0x01
#define NRF24_EN_RXADDR		0x02
#define NRF24_SETUP_AW		0x03
#define NRF24_SETUP_RETR	0x04
#define NRF24_RF_CH		0x05
#define NRF24_RF_SETUP		0x06
#define NRF24_STATUS		0x07
#define NRF24_OBSERVE_TX	0x08
#define NRF24_RPD		0x09
#define NRF24_RX_ADDR_P0	0x0A
#define NRF24_RX_ADDR_P1	0x0B
#define NRF24_RX_ADDR_P2	0x0C
#define NRF24_RX_ADDR_P3	0x0D
#define NRF24_RX_ADDR_P4	0x0E
#define NRF24_RX_ADDR_P5	0x0F
#define NRF24_TX_ADDR		0x10
#define NRF24_RX_PW_P0		0x11
#define NRF24_RX_PW_P1		0x12
#define NRF24_RX_PW_P2		0x13
#define NRF24_RX_PW_P3		0x14
#define NRF24_RX_PW_P4		0x15
#define NRF24_RX_PW_P5		0x16
#define NRF24_FIFO_STATUS	0x17
#define NRF24_ACK_PLD		0x18
#define NRF24_DYN_PD		0x1C
#define NRF24_FEATURE		0x1D

/* CONFIG */
#define NRF24_MASK_RX_DR	BIT(6)
#define NRF24_MASK_TX_DR	BIT(5)
#define NRF24_MASK_MAX_RT	BIT(4)
#define NRF24_EN_CRC		BIT(3)
#define NRF24_CRCO		BIT(2)
#define NRF24_PWR_UP		BIT(1)
#define NRF24_PRIM_RX		BIT(0)

/* STATUS */
#define NRF24_RX_DR		BIT(6)
#define NRF24_TX_DS		BIT(5)
#define NRF24_MAX_RT		BIT(4)
#define NRF24_RX_P_NO_MASK	(0x7 << 1)
#define NRF24_RX_P_NO(val)	(((val) >> 1) & 0x7)
#define NRF24_TX_FULL		BIT(0)

/* RF_SETUP */
#define NRF24_RF_DR_250K	BIT(5)
#define NRF24_RF_DR_1M		0
#define NRF24_RF_DR_2M		BIT(3)
#define NRF24_RF_PWR_M18	0
#define NRF24_RF_PWR_M12	BIT(1)
#define NRF24_RF_PWR_M6		BIT(2)
#define NRF24_RF_PWR_0		(BIT(1) | BIT(2))

/* FIFO_STATUS */
#define NRF24_FIFO_TX_REUSE	BIT(6)
#define NRF24_FIFO_TX_FULL	BIT(5)
#define NRF24_FIFO_TX_EMPTY	BIT(4)
#define NRF24_FIFO_RX_FULL	BIT(1)
#define NRF24_FIFO_RX_EMPTY	BIT(0)

/* SETUP_RETR */
#define NRF24_ARD_250us(x)	((((x)-1) & 0xFF) << 4)
#define NRF24_ARC(x)		(x)

/* FEATURE */
#define NRF24_EN_DPL		BIT(2)
#define NRF24_EN_ACK_PAY	BIT(1)
#define NRF24_EN_DYN_ACK	BIT(0)

struct nrf24_config {
	char *spi_port;

	char*cs_port;
	uint8_t cs_pin;
	char *ce_port;
	uint8_t ce_pin;
	char *irq_port;
	uint8_t irq_pin;
	gpio_callback_handler_t irq_callback;

	uint8_t payload_size;
};

struct nrf24 {
	struct nrf24_config *config;
	struct device *spi_dev;
	struct device *cs;
	struct device *ce;
	struct device *irq;
	struct gpio_callback irq_cb;
	uint8_t status;
};

static inline void nrf24_ce(struct nrf24 *nrf, int enable)
{
	gpio_pin_write(nrf->ce, nrf->config->ce_pin, enable);
}

static inline void nrf24_cs(struct nrf24 *nrf, int enable)
{
	gpio_pin_write(nrf->cs, nrf->config->cs_pin, enable);
}

static inline int nrf24_irq(struct nrf24 *nrf)
{
	uint32_t val;
	gpio_pin_read(nrf->irq, nrf->config->irq_pin, &val);
	return !val;
}

uint8_t nrf24_get_byte(struct nrf24 *nrf, uint8_t reg);
void nrf24_set_byte(struct nrf24 *nrf, uint8_t reg, uint8_t val);

void nrf24_enable_aa(struct nrf24 *nrf, uint8_t pipes);
void nrf24_enable_rx_address(struct nrf24 *nrf, uint8_t pipe);
void nrf24_set_rx_address(struct nrf24 *nrf, uint8_t pipe, uint64_t address);
uint64_t nrf24_get_rx_address(struct nrf24 *nrf, uint8_t pipe);
void nrf24_set_tx_address(struct nrf24 *nrf, uint64_t address);
uint64_t nrf24_get_tx_address(struct nrf24 *nrf);
void nrf24_set_address_width(struct nrf24 *nrf, uint8_t width);

void nrf24_flush_tx(struct nrf24 *nrf);
void nrf24_flush_rx(struct nrf24 *nrf);

void nrf24_send(struct nrf24 *nrf, uint8_t *data, uint8_t size);
int nrf24_receive(struct nrf24 *nrf, uint8_t *data);

int nrf24_init(struct nrf24 *nrf);
void nrf24_power(struct nrf24 *nrf, int on);

uint8_t nrf24_status(struct nrf24 *nrf);
```

## src/r_generator.c
```c
#include "common.h"
#include "r_generator.h"

static void generate_event(struct k_timer *timer)
{
	static u32_t counter = 0;
	struct event event = {
		.sensor_addr = 0xA0 + (counter % 16),
		.timestamp = k_uptime_get(),
		.event_type = 1 + (counter % 3),
		.event_data = 0,
	};
	counter++;

	while (k_msgq_put(&event_queue, &event, K_NO_WAIT) != 0)
		k_msgq_purge(&event_queue);
}
K_TIMER_DEFINE(event_generation_timer, generate_event, NULL);

void toggle_r_generation(void)
{
	if (k_timer_remaining_get(&event_generation_timer))
		k_timer_stop(&event_generation_timer);
	else
		k_timer_start(&event_generation_timer,
			K_MSEC(1000), K_MSEC(1000));
}
```

## src/r_generator.h
```c
#pragma once

void toggle_r_generation(void);
```
